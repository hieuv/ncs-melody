## CMakeLists.txt
```
# SPDX-License-Identifier: Apache-2.0

cmake_minimum_required(VERSION 3.20.0)
find_package(Zephyr REQUIRED HINTS $ENV{ZEPHYR_BASE})
project(blinky)

target_include_directories(app PRIVATE inc/)
target_sources(
    app PRIVATE 
    src/main.c 
    src/sound_gen.c 
    src/music.c 
    src/instruments.c 
    src/song_god_rest_ye.c 
    src/song_holy_night.c
    src/song_xmas.c
    )
```

## prj.conf
```kconfig
CONFIG_GPIO=y
CONFIG_NRFX_PWM1=y
CONFIG_NEWLIB_LIBC=y
CONFIG_CBPRINTF_FP_SUPPORT=y

# Enable Shell with UART and Dummy backend. 
# The dummy backend is necessary for enabling Shell over MCUmgr 
CONFIG_SHELL=y
CONFIG_SHELL_BACKEND_SERIAL=y
CONFIG_SERIAL=y
CONFIG_SHELL_BACKEND_DUMMY=y

# Enable MCUmgr Shell feature
CONFIG_MCUMGR=y
CONFIG_NET_BUF=y    # MCUmgr dependency
CONFIG_ZCBOR=y      # MCUmgr dependency
CONFIG_MCUMGR_GRP_SHELL=y

# Enable MCUmgr over Bluetooth LE
CONFIG_MCUMGR_TRANSPORT_BT=y

# Enable automatic connection parameter negotiation suitable for MCUmgr
CONFIG_MCUMGR_TRANSPORT_BT_CONN_PARAM_CONTROL=y

# Enable MCUmgr message reassembly
CONFIG_MCUMGR_TRANSPORT_BT_REASSEMBLY=y

# Enable Bluetooth LE Peripheral
CONFIG_BT=y
CONFIG_BT_PERIPHERAL=y
CONFIG_BT_DEVICE_NAME="Xmas Music Box"

# Enable higher BLE GATT MTU and GAP Data Length
# Shell commands would not work with small MTU
CONFIG_BT_USER_DATA_LEN_UPDATE=y
CONFIG_BT_USER_PHY_UPDATE=y
CONFIG_BT_GAP_AUTO_UPDATE_CONN_PARAMS=n
CONFIG_BT_BUF_ACL_RX_SIZE=502
CONFIG_BT_ATT_PREPARE_COUNT=2
CONFIG_BT_L2CAP_TX_BUF_COUNT=10
CONFIG_BT_L2CAP_TX_MTU=498
CONFIG_BT_CONN_TX_MAX=10
CONFIG_BT_BUF_ACL_TX_COUNT=10
CONFIG_BT_BUF_ACL_TX_SIZE=502

# Restrict number of connections supported to lower RAM consumption
CONFIG_BT_MAX_CONN=1

# Enable logging over RTT
CONFIG_LOG=y
CONFIG_LOG_BACKEND_RTT=y
CONFIG_USE_SEGGER_RTT=y

# Enable Kernel Events API
CONFIG_EVENTS=y
```

## src/main.c
```c
#include <zephyr/bluetooth/bluetooth.h>
#include <zephyr/kernel.h>
#include <zephyr/shell/shell.h>
#include <errno.h>

#include <hal/nrf_gpiote.h>
#include <hal/nrf_gpio.h>
#include <nrfx_pwm.h>

#include <sound_gen.h>
#include <songs.h>

#include <math.h>

#ifndef CONFIG_BOARD_THINGY53_NRF5340_CPUAPP
#warning "This project was made for the thingy53_nrf5340_cpuapp target. Please perform necessary updates for other targets"
#endif

#define PWM_COUNTERTOP  255

#define PWM_BUF_LENGTH 1000

// Thingy53 Buzzer pin
#define PWM_PIN NRF_GPIO_PIN_MAP(1, 15)

K_SEM_DEFINE(sem_update_pwm_buf, 0, 1);

K_EVENT_DEFINE(music_ctrl_evts);
#define MUSIC_CTRL_EVTS_START_BIT	((uint32_t) 0x01U << 0)
#define MUSIC_CTRL_EVTS_STOP_BIT	((uint32_t) 0x01U << 1)
#define MUSIC_CTRL_EVTS_ALL_BITS	(MUSIC_CTRL_EVTS_START_BIT | MUSIC_CTRL_EVTS_STOP_BIT)

static const struct bt_data ad[] = {
	BT_DATA_BYTES(BT_DATA_FLAGS, (BT_LE_AD_GENERAL | BT_LE_AD_NO_BREDR)),
	BT_DATA_BYTES(BT_DATA_UUID128_ALL,
		      0x84, 0xaa, 0x60, 0x74, 0x52, 0x8a, 0x8b, 0x86,
		      0xd3, 0x4c, 0xb7, 0x1d, 0x1d, 0xdc, 0x53, 0x8d),
};

static nrfx_pwm_t my_pwm = NRFX_PWM_INSTANCE(1);
static int buf_to_update_index;

void nrfx_pwm_handler(nrfx_pwm_evt_type_t event_type, void * p_context)
{
	switch(event_type) {
		case NRFX_PWM_EVT_END_SEQ0:
			buf_to_update_index = 0;
			k_sem_give(&sem_update_pwm_buf);
			break;
		case NRFX_PWM_EVT_END_SEQ1:
			buf_to_update_index = 1;
			k_sem_give(&sem_update_pwm_buf);
			break;
		default:
			break;
	}
}

static int pwm_init(void)
{
	static nrfx_pwm_config_t const config0 =
    {
        .output_pins =
        {
            PWM_PIN,				// channel 0
            NRFX_PWM_PIN_NOT_USED,	// channel 1
            NRFX_PWM_PIN_NOT_USED,	// channel 2
            NRFX_PWM_PIN_NOT_USED	// channel 3
        },
        .irq_priority = 5,
        .base_clock   = NRF_PWM_CLK_16MHz,
        .count_mode   = NRF_PWM_MODE_UP,
        .top_value    = PWM_COUNTERTOP,
        .load_mode    = NRF_PWM_LOAD_COMMON,
        .step_mode    = NRF_PWM_STEP_AUTO
    };
    return (nrfx_pwm_init(&my_pwm, &config0, nrfx_pwm_handler, NULL) == NRFX_SUCCESS) ? 0 : -1;

	// If PWM callbacks are to be used, remember to configure the interrupts correctly
	IRQ_CONNECT(PWM1_IRQn, 0, nrfx_pwm_1_irq_handler, 0, 0);
	irq_enable(PWM1_IRQn);
}

//static nrf_pwm_values_common_t *next_buf;
// This array cannot be allocated on stack (hence "static") and it must be in RAM 
static nrf_pwm_values_common_t seq_values[PWM_BUF_LENGTH];
static nrf_pwm_values_common_t seq_values_b[PWM_BUF_LENGTH];

static void pwm_set_duty_cycle()
{
	sg_fill_buffer(seq_values, PWM_BUF_LENGTH);
	sg_fill_buffer(seq_values_b, PWM_BUF_LENGTH);

    static nrf_pwm_sequence_t const seq =
    {
        .values.p_common = (const nrf_pwm_values_common_t*)&seq_values,
        .length          = PWM_BUF_LENGTH,
        .repeats         = 1,
        .end_delay       = 0
    };

	static nrf_pwm_sequence_t const seq2 =
    {
        .values.p_common = (const nrf_pwm_values_common_t*)&seq_values_b,
        .length          = PWM_BUF_LENGTH,
        .repeats         = 1,
        .end_delay       = 0
    };
	nrfx_pwm_complex_playback(&my_pwm, &seq, &seq2, 1, NRFX_PWM_FLAG_SIGNAL_END_SEQ0 | NRFX_PWM_FLAG_SIGNAL_END_SEQ1 | NRFX_PWM_FLAG_LOOP);
}

extern volatile bool stop_playing_flag;

static int cmd_stop(
	const struct shell *shell, size_t argc, char *argv[])
{
    shell_fprintf(shell, SHELL_NORMAL, "ACK music_box stop\n");
	k_event_post(&music_ctrl_evts, MUSIC_CTRL_EVTS_STOP_BIT);
	stop_playing_flag = true;
	return 0;
}
 
static int cmd_play(
	const struct shell *shell, size_t argc, char *argv[])
{
	shell_fprintf(shell, SHELL_NORMAL, "ACK music_box play\n");
	k_event_post(&music_ctrl_evts, MUSIC_CTRL_EVTS_START_BIT);
    return 0;
}
 
SHELL_STATIC_SUBCMD_SET_CREATE(
	music_box_cmds,
	SHELL_CMD(play, NULL,
		"usage example:\n$ music_box play\n",
		cmd_play),
	SHELL_CMD(stop, NULL,
		"usage example:\n$ music_box stop\n",
		cmd_stop),
	SHELL_SUBCMD_SET_END
	);

SHELL_CMD_REGISTER(music_box, &music_box_cmds, "Control Music Box", NULL);

int main(void)
{
	int err;
	
	pwm_init();
	pwm_set_duty_cycle();

	err = bt_enable(NULL);
	if (err) {
		printk("ERROR bt_enable %d", err);
		while (1) { /* spin */ };
	}

	err = bt_le_adv_start(BT_LE_ADV_CONN_NAME, ad, ARRAY_SIZE(ad), NULL, 0);
	if (err) {
		printk("ERROR bt_le_adv_start %d", err);
		while (1) { /* spin */ };
	}

	printk("Hello\n");

	sg_init();
	
	while (1) {
		k_sem_take(&sem_update_pwm_buf, K_FOREVER);
		switch(buf_to_update_index) {
			case 0:
				sg_fill_buffer(seq_values, PWM_BUF_LENGTH);
				break;
			case 1:
				sg_fill_buffer(seq_values_b, PWM_BUF_LENGTH);
				break;
			default:
				break;
		}
	}

	return 0;
}

void thread_play_notes_func(void)
{
	while (1) {
		volatile uint32_t evts= 0;
		static volatile bool is_playing = false;
		
		evts = k_event_wait(&music_ctrl_evts, MUSIC_CTRL_EVTS_ALL_BITS, false, K_MSEC(10));
		
		if ((evts & MUSIC_CTRL_EVTS_START_BIT) != 0) {
			is_playing = true;
		}
		if ((evts & MUSIC_CTRL_EVTS_STOP_BIT) != 0) {
			is_playing = false;
		}

		k_event_clear(&music_ctrl_evts, MUSIC_CTRL_EVTS_ALL_BITS);

		if (is_playing) {
			static music_songdef_t* playlist[] = {
				&song_santa_claus_is_coming_to_town,
				&song_paa_laaven_sitter_nissen,
				&song_holy_night,
				&song_god_rest_ye_gentlemen
			};
			static size_t playlist_play_idx = 0;
			music_play_song(playlist[playlist_play_idx]);
			playlist_play_idx++;
			if (playlist_play_idx >= (sizeof(playlist) / sizeof(music_songdef_t*))) {
				playlist_play_idx = 0;
			}
		}
	}
}

K_THREAD_DEFINE(thread_play_notes, 1024, thread_play_notes_func, 0, 0, 0, K_LOWEST_APPLICATION_THREAD_PRIO, 0, 100); 
```

## inc/instruments.h
```c
#ifndef __INSTRUMENTS_H
#define __INSTRUMENTS_H

#include <zephyr/kernel.h>
#include <sound_gen.h>

extern sg_instrument_t instr_lead1;
extern sg_instrument_t instr_lead1_long;
extern sg_instrument_t instr_bass1;
extern sg_instrument_t instr_drum_snare;

#endif
```

## inc/music.h
```c
#ifndef __MUSIC_H
#define __MUSIC_H

#include <zephyr/kernel.h>
#include <sound_gen.h>

#define N_C 0
#define N_CS 1
#define N_Db 1
#define N_D 2
#define N_Eb 3
#define N_E 4
#define N_F 5
#define N_Gb 6
#define N_G 7
#define N_Ab 8
#define N_A 9
#define N_Bb 10
#define N_B 11

#define NOTE(a,b) (a+b*12)
#define NOTE_PAUSE 	100001
#define NOTE_END	100002
#define NOTE_REP	100003

#define MAX_NOTE_LISTS 4

typedef struct {
	int note;
	int duration;
	int amp;
} music_notedef_t;

typedef struct {
	int octave_prev;
	int length_prev;
	int amp_prev;
	const char* str_pointer;
} str_decode_context_t;

typedef struct {
	int index;
	bool active;
	bool mute;
	int current_note_lifetime;
	sg_instrument_t *instrument;
	int note_offset;
	int repeat_counter;
	str_decode_context_t str_decode_context;
	const char *note_string;
} music_notelist_t;

typedef struct {
	int speed;
	int max_amp;
	music_notelist_t note_lists[MAX_NOTE_LISTS];
	int num_note_lists;
} music_songdef_t;


extern music_songdef_t song_god_rest_ye_gentlemen;

int music_play_song(music_songdef_t *song);

#endif
```

## inc/songs.h
```c
#ifndef __SONGS_H
#define __SONGS_H

#include <zephyr/kernel.h>
#include <sound_gen.h>
#include <music.h>
#include <instruments.h>

extern music_songdef_t song_god_rest_ye_gentlemen;
extern music_songdef_t song_holy_night;
extern music_songdef_t song_short_dbg;
extern music_songdef_t song_santa_claus_is_coming_to_town;
extern music_songdef_t song_paa_laaven_sitter_nissen;

#endif
```

## inc/sound_gen.h
```c
#ifndef __SOUND_GEN_H
#define __SOUND_GEN_H

#include <zephyr/kernel.h>
#include <nrfx_pwm.h>

#define NUM_OSCILLATORS 16
#define SG_ADSR_SUBDIV 100
#define SG_SAMPLE_FREQ 31250
#define SG_SAMPLES_PR_MS 31

#define NUM_OCTAVES 7
#define NOTES_PR_OCTAVE 12
#define OCTAVE_0_START_FREQ 55.0f
#define HALF_NOTE_FACTOR 1.05946309f

struct sg_osc_state_s;
typedef struct og_osc_state_s sg_osc_state_t;

typedef struct {
	float a;
	float d;
	float s;
	float r;
	float result;
} sg_adsr_t;

typedef float (*osc_gen_func_t)(sg_osc_state_t *state);

struct og_osc_state_s {
	bool used;
	float t;
	uint32_t t_i;
	uint32_t phase_i;
	uint32_t phase_diff_i;
	uint32_t amp_i;
	float amplitude;
	float frequency;
	float val;

	// Instrument variables
	float global_amplitude;
	sg_adsr_t adsr;
	osc_gen_func_t func;
};

typedef struct {
	osc_gen_func_t gen_func;
} sg_oscillator_t;

typedef struct {
	float a, d, s, r;
	float amp_base;
	osc_gen_func_t osc_func;
} sg_instrument_t;

float gen_func_sinus(sg_osc_state_t *state);

float gen_func_square(sg_osc_state_t *state);

float gen_func_sawtooth(sg_osc_state_t *state);

float gen_func_noise(sg_osc_state_t *state);

void sg_init();

void sg_fill_buffer(nrf_pwm_values_common_t *dst_ptr, int num);

int sg_play_freq(float frequency, float amp, sg_instrument_t *instr);

int sg_play_note(int note_index, float amp, sg_instrument_t *instr);

#endif
```

## src/instruments.c
```c
#include <instruments.h>

sg_instrument_t instr_lead1 = {
    .a = 50,
    .d = 100,
    .s = 100,
    .r = 200,
    .amp_base = 0.7f,
    .osc_func = gen_func_square,
};

sg_instrument_t instr_lead1_long = {
    .a = 250,
    .d = 1000,
    .s = 500,
    .r = 500,
    .amp_base = 0.7f,
    .osc_func = gen_func_sawtooth,
};

sg_instrument_t instr_bass1 = {
	.a = 50,
    .d = 100,
    .s = 150,
    .r = 300,
    .amp_base = 0.4f,
    .osc_func = gen_func_sawtooth,
};

sg_instrument_t instr_drum_snare = {
	.a = 30,
    .d = 100,
    .s = 0,
    .r = 120,
    .amp_base = 0.3f,
    .osc_func = gen_func_noise,
};
```

## src/music.c
```c
#include <music.h>
#include <sound_gen.h>
#include <string.h>
#include <ctype.h>

const int str_keywords_index[] = {0, 1, 1, 2, 3, 4, 5, 6, 7, 8, 9, 10, 11,                              NOTE_PAUSE, NOTE_END};
const char *str_keywords[] = {"c", "cs", "db", "d", "eb", "e", "f", "gb", "g", "ab", "a", "bb", "b",    "p",         "end"};
#define STR_KEYWORD_LIST_LEN (sizeof(str_keywords) / sizeof(str_keywords[0]))

volatile bool stop_playing_flag = false;

static const unsigned char *parse_number(const unsigned char *string, int *number)
{
	*number = 0;
	while(isdigit(*string)) {
		*number *= 10;
		*number += (int)(*string - '0');
		string++;
	}
	return string;
}

static const unsigned char *music_string_parser(str_decode_context_t *context, music_notedef_t *note)
{
	const unsigned char *string = context->str_pointer;
	unsigned char keyword[16];
	int i, k, octave, length, amp;
	
	// Check for end of string
	if(*string == 0) return 0;
	
	// Find the keyword
	for(i = 0; i < 15 && *string != ',' && *string != '-'; i++) {
		keyword[i] = tolower(*string++);
	}
	keyword[i] = 0;

	// Check if there is a octave index after the note
	if(isdigit(keyword[i-1])) {
		context->octave_prev = octave = (int)(keyword[i-1] - '0');
		// Shave the octave digit of the keyword
		keyword[i-1] = 0;
		//printk("[oct %i]", octave);
	} else octave = context->octave_prev;
	//printk("[kwd %s]", keyword);

	// Look for a matching keyword
	for(k = 0; k < STR_KEYWORD_LIST_LEN; k++) {
		if(strcmp(keyword, str_keywords[k]) == 0) {
			break;
		}
	}
	if(str_keywords_index[k] < 12) {
		// Regular note
		note->note = str_keywords_index[k];
	} else if(str_keywords_index[k] == NOTE_END) {
		return 0;
	} else if(str_keywords_index[k] == NOTE_PAUSE) {
		note->note = NOTE_PAUSE;
	}

	// Check if there is a length specifier
	if(*string == '-') {
		string = parse_number(string+1, &length);
		context->length_prev = length;
	} else length = context->length_prev;

	// Check if there is an amp specifier
	if(*string == '-') {
		string = parse_number(string+1, &amp);
		context->amp_prev = amp;
	} else amp = context->amp_prev;
	if(note->note != NOTE_PAUSE) note->note += octave*12;
	note->duration = length;
	note->amp = amp;
	
	// Check for end of string
	if(*string == 0) return 0;
	// Return the byte after the next delimiter
	return string+1;
}

static void fetch_note(const music_songdef_t *song, music_notelist_t *notelist, const music_notedef_t *note)
{
	if(note->note != NOTE_PAUSE) {
		//printk("\nFetched note: note %i, dur %i amp %i, instr %i ", note->note, note->duration, note->amp, notelist->instrument);
		sg_play_note(note->note + notelist->note_offset, (float)note->amp / (float)song->max_amp, notelist->instrument);
	}
}

int music_play_song(music_songdef_t *song)
{
	int active_lists;
	music_notedef_t current_note[MAX_NOTE_LISTS], note;
	printk("Playing song...\n");
	for(int i = 0; i < song->num_note_lists; i++) {
		song->note_lists[i].active = true;
		song->note_lists[i].index = 0;
		song->note_lists[i].repeat_counter = 0;
		song->note_lists[i].str_decode_context.str_pointer = song->note_lists[i].note_string;
	}
	do {
		active_lists = 0;
		for(int nl = 0; nl < song->num_note_lists; nl++) {
			if (stop_playing_flag) break;
			if(song->note_lists[nl].active) {
				if(song->note_lists[nl].index == 0 || song->note_lists[nl].current_note_lifetime >= current_note[nl].duration) {
					// Fetch a new note
					const unsigned char *next_ptr = music_string_parser(&(song->note_lists[nl].str_decode_context), &note);
					song->note_lists[nl].index++;
					if(next_ptr == 0 || song->note_lists[nl].mute) {
						song->note_lists[nl].active = false;
					} else {
						current_note[nl] = note;
						song->note_lists[nl].str_decode_context.str_pointer = next_ptr;
						fetch_note(song, &(song->note_lists[nl]), &note);
						song->note_lists[nl].current_note_lifetime = 1;
					}
				} else {
					song->note_lists[nl].current_note_lifetime++;
				}
				active_lists++;
			}
		}
		if (stop_playing_flag) break;
		k_msleep(song->speed);
	} while(active_lists > 0);
	stop_playing_flag = false;
	printk("Song completed\n");
	return 0;
}
```

## src/song_god_rest_ye.c
```c
#include <songs.h>

const char god_rest_ye_melody[] = "P-30,C3-2-120,C,G,G,F,Eb,D,C,Bb2,C3,D,Eb,F,G-6,C-2," \
								  "C3-2-80,G,G,F,Eb,D,C,Bb2,C3,D,Eb,F,G-6,G-2," \
								  "Ab,F,G,Ab,Bb,C4,G3,F,Eb,C,D,Eb,F-4,Eb-2,F," \
								  "G,Ab,Bb,C4,G3,F,Eb,D,C-8,";
const char god_rest_ye_bass[]   = "P-32," \
								  "C2-4-80,C-2,C,C-4,C-2,C,C-4,C-2,C,G,F,Eb,D," \
								  "C2-4,B1-2,G,C2-4,C,D-2,F,Eb,C,G-4,G," \
								  "F-4,D,Eb,Eb-2,D,C-4,C-2,Eb,G-4,G," \
								  "F-2,G,F,D,Eb,D,C,Eb,G,F,Eb,D,C-4,C1-4,";

const char god_rest_ye_drums[]  = "C0-4-10,C-2-15,C-2-22,C-4-33,C-2-44,C-2-55,C-4-66,C-2-77,C-2-88,C-4-99,C-2,C-2," \
								  "C0-4-100,C-2,C-2,C-4,C-2,C-2,C-4,C-2,C-2,C-4,C-2,C-2," \
								  "C0-4-100,C-2,C-2,C-4,C-2,C-2,C-4,C-2,C-2,C-4,C-2,C-2," \
								  "C0-4-100,C-2,C-2,C-4,C-2,C-2,C-4,C-2,C-2,C-4,C-2,C-2," \
								  "C0-4-100,C-2,C-2,C-4,C-2,C-2,C-4-90,C-2-70,C-2-50,C-4-36,C-2-15,C-2-5,";

music_songdef_t song_god_rest_ye_gentlemen = {
	.max_amp = 120,
	.note_lists[0].note_string = god_rest_ye_melody,
	.note_lists[0].instrument = &instr_lead1,
	.note_lists[0].note_offset = 12,
	.note_lists[1].note_string = god_rest_ye_bass,
	.note_lists[1].instrument = &instr_bass1,
	.note_lists[1].note_offset = -12,
	.note_lists[2].note_string = god_rest_ye_drums,
	.note_lists[2].instrument = &instr_drum_snare,
	.note_lists[2].note_offset = 0,
	.num_note_lists = 3,
	.speed = 120,
};
```

## src/song_holy_night.c
```c
#include <songs.h>

const char holy_night_1[] = "G3-3-100,A-1,G-2,E-6,G-3,A-1,G-2,E-6," \
                            "D4-4,D-2,B3-6,C4-4,C-2,G3-6,"\
                            "A-4,A-2,C4-3,B3-1,A-2,G-3,A-1,G-2,E-6,A-4,A-2,C4-3,B3-1,A-2,G-3,A-1,G-2,E-6," \
                            "D4-3,D-1,D-2,F,D,B3,C4-6,E-6,C-3,G3-1,E-2,G-3,F-1,D-2,C-12,";

const char holy_night_2[] = "E3-3-100,F-1,E-2,C-6,E-3,F-1,E-2,C-6," \
                            "F3-4,F-2,D-6,E4-4,E-2,C3-6,"\
                            "F-4,F-2,A4-3,G3-1,F-2,E-3,F-1,E-2,C-6,F-4,F-2,A4-3,G3-1,F-2,E-3,F-1,E-2,C-6," \
                            "F-3,F-1,F-2,D,G,F,E4-6,C-6,E-3,E-1,C-2,B2-3,C3-1,D-2,E-12";

const char holy_night_bass[] = "C2-1-100,G1,C2,E,G,G1,C2,G1,C2,E,G,E," \
                            "C2-1-100,G1,C2,E,G,G1,C2,G1,C2,E,G,E," \
                            "D,E,F,A,D3,C,B2,A,C3,G2,F,E,G,C,E,F,D,E,G,C,B1,A,G,C2,";


music_songdef_t song_holy_night = {
	.max_amp = 120,
	.note_lists[0].note_string = holy_night_1,
	.note_lists[0].instrument = &instr_lead1_long,
	.note_lists[0].note_offset = 12,
    //.note_lists[0].mute=true,
    //.note_lists[1].mute=true,

	.note_lists[1].note_string = holy_night_2,
	.note_lists[1].instrument = &instr_lead1_long,
	.note_lists[1].note_offset = 12,
	.note_lists[2].note_string = holy_night_bass,
	.note_lists[2].instrument = &instr_bass1,
	.note_lists[2].note_offset = 0,
	.num_note_lists = 3,
	.speed = 300,
};
```

## src/song_xmas.c
```c
#include <songs.h>

const char boot_tune[] = "G3-3-100,A-4,B-4,C-4,B-4,A-4,end";

music_songdef_t song_short_dbg = {
	.max_amp = 120,
	.note_lists[0].note_string = boot_tune,
	.note_lists[0].instrument = &instr_lead1,
	.note_lists[0].note_offset = 0,
	.num_note_lists = 1,
	.speed = 300,
};

const char santa_claus_is_coming_to_town_track_1[] = 
	"G3-2-100,E-1,F-1,G-2,G-3,G-1,A-1,B-1,C4-2,C-2,2,E3-1,F-1,G-2,G-2,G-2,A-1,G-1,F-2,F-2,P-2,E-2,G-2,C-2,E-2,D-2,F-4,B2-2,G3-8,end";
const char santa_claus_is_coming_to_town_track_2[] = 
	"B2-2-100,C3-4,E2-4,F-4,A-4,C3-4,Bb2-4,A-4,Ab-4,G-4,A-4,F-4,G-4,C-8,end";

music_songdef_t song_santa_claus_is_coming_to_town = {
	.max_amp = 120,
	.note_lists[0].note_string = santa_claus_is_coming_to_town_track_1,
	.note_lists[0].instrument = &instr_lead1,
	.note_lists[0].note_offset = 0,
	.note_lists[1].note_string = santa_claus_is_coming_to_town_track_2,
	.note_lists[1].instrument = &instr_lead1,
	.note_lists[1].note_offset = 0,
	.num_note_lists = 2,
	.speed = 200,
};

const char paa_laaven_sitter_nissen_track_1[] = 
	"D2-1-100,G-1,Gb-1,G-1,A-1,B-1,A-1,B-1,C3-1,E-2,D-2,D-3,B2-1,D3-2,C-2,C-3,A2-1,C3-2,B2-2,B-3,D-1," \
    "G-1,Gb-1,G-1,A-1,B-1,A-1,B-1,C3-1,E-2,D-2,D-3,B2-1,D3-2,C-2,C-1,Gb2-1,Gb-1,Gb-1,G-2,B-2,G-2,G-2," \
    "E3-1,D-1,C-1,B2-1,D3-1,C-1,B2-1,A-1,G-4,E-2,G-1,G-1,F-4,D-2,A-1,A-1,G-4,E-2,G-2," \
    "E3-1,D-1,C-1,B2-1,D3-1,C-1,B2-1,A-1,G-4,E-2,G-1,G-1,A-2,D3-2,C-1,B2-1,A-1,B-1,C3-2,C3-2,C3-2,end";
const char paa_laaven_sitter_nissen_track_2[] = 
	"P-1-100,G1-4,D-4,G-4,D-4,D-4,A-2,D-2,G-4,D-4,G-4,D-4,G-4,E-4,A-4,D-2,A-2,G-2,D-2,G-4," \
	"C-4,F-4,E-4,C-2,Cs-2,D-4,G-4,C2-4,G1-4,C-4,F-4,C-4,G-2,C-2,D-4,G-4,G-2,G-2,G-2,end";

music_songdef_t song_paa_laaven_sitter_nissen = {
	.max_amp = 120,
	.note_lists[0].note_string = paa_laaven_sitter_nissen_track_1,
	.note_lists[0].instrument = &instr_lead1,
	.note_lists[0].note_offset = 0,
	.note_lists[1].note_string = paa_laaven_sitter_nissen_track_2,
	.note_lists[1].instrument = &instr_lead1,
	.note_lists[1].note_offset = 0,
	.num_note_lists = 2,
	.speed = 200,
};
```

## src/sound_gen.c
```c
#include <sound_gen.h>
#include <math.h>
#include <stdlib.h>

static sg_osc_state_t m_osc_list[NUM_OSCILLATORS];

float sin_table[256];

float note_table[NUM_OCTAVES*NOTES_PR_OCTAVE];

static sg_osc_state_t *alloc_oscillator(void)
{
	for(int i = 0; i < NUM_OSCILLATORS; i++) {
		if(!m_osc_list[i].used) {
			m_osc_list[i].used = true;
			return &m_osc_list[i];
		}
	}
	return 0;
} 

float gen_func_sinus(sg_osc_state_t *state)
{
	return sin_table[state->phase_i >> 8];
}

float gen_func_square(sg_osc_state_t *state)
{
	if(state->phase_i > 0x8000) return 1.0f;
	else return -1.0f;
}

float gen_func_sawtooth(sg_osc_state_t *state)
{
	return ((float)state->phase_i / 32768.0f) - 1.0f;
}

float gen_func_noise(sg_osc_state_t *state)
{
	return (float)(rand()%0x1000) *2.0f / (float)0x1000 - 1.0f;
}

static bool run_adsr_comp(sg_adsr_t *adsr, uint32_t t)
{
	static float tmp;
	float tf = (float)t;
	if(tf < adsr->a) {
		adsr->result = tf / adsr->a;
	} else if(tf < adsr->s) {
		adsr->result = 1.0f;
	} else if(tf < (adsr->s + adsr->r)){
		tmp = (tf - adsr->s);
		adsr->result = (adsr->r - (tf - adsr->s)) / adsr->r;
	} else {
		adsr->result = 0.0f;
		return true;
	}
	return false;
}

void sg_fill_buffer(nrf_pwm_values_common_t *dst_ptr, int num)
{
	sg_osc_state_t *osc;
	static float tmp_res_buf[1000];
	int active_oscillators = 0;
	for(int i = 0; i < num; i++) tmp_res_buf[i] = 0.0f;
	// float result;
	for(int osc_index = 0; osc_index < NUM_OSCILLATORS; osc_index++) {
		if(m_osc_list[osc_index].used) {
			active_oscillators++;
			osc = &m_osc_list[osc_index];
			for(int i = 0; i < num; i++) {
				tmp_res_buf[i] += osc->func(osc)*osc->adsr.result;
				osc->t_i++;
				osc->phase_i = (osc->phase_i + osc->phase_diff_i) & 0xFFFF;
				if((i%SG_ADSR_SUBDIV) == 0) {
					if(run_adsr_comp(&osc->adsr, osc->t_i / SG_SAMPLES_PR_MS)) {
						osc->used = false;
						//printk("Freeing osc\n");
						break;
					}
					// For simplicity we bake amplitude calculations into the ADSR result
					osc->adsr.result = osc->adsr.result * osc->amplitude * osc->global_amplitude;
				}
			}
		}
	}
	if(active_oscillators == 0) {
		for(int i = 0; i < num; i++) dst_ptr[i] = 127;
	} else {
		for(int i = 0; i < num; i++) dst_ptr[i] = (uint16_t)((tmp_res_buf[i] + 1.0f) * 127.0f);
	}
}

int sg_play_freq(float frequency, float amp, sg_instrument_t *instr)
{
	sg_osc_state_t *new_osc = alloc_oscillator();
	if(new_osc) {
		new_osc->t = 0.0f;
		new_osc->frequency = frequency;
		new_osc->amplitude = amp;
		new_osc->t_i = 0;
		new_osc->phase_i = 0;
		new_osc->phase_diff_i = (uint32_t)(frequency * 256.0f * 256.0f / (float)SG_SAMPLE_FREQ);
		new_osc->adsr.a = instr->a;
		new_osc->adsr.d = instr->d;
		new_osc->adsr.s = instr->s;
		new_osc->adsr.r = instr->r;
		new_osc->global_amplitude = instr->amp_base;
		new_osc->func = instr->osc_func;
		return 0;
	}
	return -1;
}

int sg_play_note(int note_index, float amp, sg_instrument_t *instr)
{
	if(note_index >= (NUM_OCTAVES*NOTES_PR_OCTAVE)) return -1;
	return sg_play_freq(note_table[note_index], amp, instr);
}

#define PI 3.14159265358979f
void sg_init(void)
{
	for(int i = 0; i < NUM_OSCILLATORS; i++) {
		m_osc_list[i].used = false;
	}
	for(int i = 0; i < 256; i++) {
		sin_table[i] = sinf(PI * 2.0f * (float)i / 256.0f);
	}
	for(int i = 0; i < NUM_OCTAVES; i++) {
		note_table[i*NOTES_PR_OCTAVE] = OCTAVE_0_START_FREQ * (float)(1 << i);
		for(int note = 1; note < NOTES_PR_OCTAVE; note++) {
			note_table[i*NOTES_PR_OCTAVE + note] = note_table[i*NOTES_PR_OCTAVE + note - 1] * HALF_NOTE_FACTOR;
		}
	}
}
```
